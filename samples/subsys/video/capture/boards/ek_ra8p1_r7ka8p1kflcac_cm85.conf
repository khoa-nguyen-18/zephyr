## samples/subsys/video/capture/boards/ek_ra8p1_r7ka8p1kflcac_cm85.conf
```kconfig
CONFIG_VIDEO_FRAME_WIDTH=1024
CONFIG_VIDEO_FRAME_HEIGHT=600
CONFIG_VIDEO_PIXEL_FORMAT="YUYV"
CONFIG_VIDEO_BUFFER_POOL_NUM_MAX=8
CONFIG_VIDEO_BUFFER_POOL_HEAP_SIZE=10485760
CONFIG_VIDEO_BUFFER_POOL_ZEPHYR_REGION=y
CONFIG_VIDEO_BUFFER_POOL_ZEPHYR_REGION_NAME="SDRAM"
CONFIG_MEMC=y
CONFIG_VIDEO_CAM_NUM_BUFS=8
CONFIG_LOG_BUFFER_SIZE=32768
CONFIG_CACHE_MANAGEMENT=y
CONFIG_DCACHE=y
```
